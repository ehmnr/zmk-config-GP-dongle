## boards/nice60_dongle/Kconfig.shield
```kconfig
# Copyright (c) 2020 The ZMK Contributors
# SPDX-License-Identifier: MIT
config BOARD_nice60_dongle
	def_bool $(boards_list_contains,nice60_dongle)
```

## boards/shields/config/Kconfig.shield
```kconfig
# Copyright (c) 2020 The ZMK Contributors
# SPDX-License-Identifier: MIT

config SHIELD_nice60_peri
	def_bool $(shields_list_contains,nice60_peri)

config SHIELD_nice60_dongle
	def_bool $(shields_list_contains,nice60_dongle)
```

## config/Kconfig.defconfig
```kconfig
# Copyright (c) 2021 Nick Winans
# SPDX-License-Identifier: MIT

if SHIELD_nice60_dongle

config ZMK_KEYBOARD_NAME
    default "nice!60"

if USB_DEVICE_STACK

config USB_NRFX
    default y

endif # USB_DEVICE_STACK

config BT_CTLR
    default BT

endif




if SHIELD_nice60_dongle

config ZMK_SPLIT_BLE_ROLE_CENTRAL
	default y

config ZMK_USB
	default y

config ZMK_SPLIT
	default y

config ZMK_BLE
	default y

endif

if BOARD_NICE60

config ZMK_SPLIT
	default y

config ZMK_BLE
	default y

endif
```
